## package/freeimage/Config.in
```kconfig
config BR2_PACKAGE_FREEIMAGE
	bool "freeimage"
	depends on BR2_INSTALL_LIBSTDCPP
	help
	  Freeimage

comment "freeimage w/ C++"
	depends on !BR2_INSTALL_LIBSTDCPP
```

## package/pmw-modules/Config.in
```kconfig
config BR2_PACKAGE_PMW_MODULES
	bool "pmw-modules"
	depends on BR2_arm
	depends on BR2_INSTALL_LIBSTDCPP
	depends on BR2_TOOLCHAIN_HAS_THREADS
	depends on !BR2_STATIC_LIBS
	depends on BR2_PACKAGE_HAS_LIBEGL
	depends on BR2_PACKAGE_HAS_LIBGLES
	depends on BR2_PACKAGE_HAS_LIBOPENMAX
	select BR2_PACKAGE_X264
	select BR2_PACKAGE_FFMPEG

	help
	  PMW related modules

comment "pmw-modules needs a toolchain w/ C++, threads, dynamic library, egl, openmax and opengles"
	depends on BR2_arm
	depends on !BR2_INSTALL_LIBSTDCPP || !BR2_TOOLCHAIN_HAS_THREADS || \
		BR2_STATIC_LIBS || !BR2_PACKAGE_HAS_LIBEGL || !BR2_PACKAGE_HAS_LIBGLES || !BR2_PACKAGE_HAS_LIBOPENMAX
 
```

## package/pmw-vidplayer/Config.in
```kconfig
config BR2_PACKAGE_PMW_VIDPLAYER
	bool "pmw-vidplayer"
	depends on BR2_arm
	depends on BR2_INSTALL_LIBSTDCPP
	depends on BR2_TOOLCHAIN_HAS_THREADS
	depends on !BR2_STATIC_LIBS
	depends on BR2_PACKAGE_HAS_LIBEGL
	depends on BR2_PACKAGE_HAS_LIBGLES
	depends on BR2_PACKAGE_HAS_LIBOPENMAX
	select BR2_PACKAGE_X264
	select BR2_PACKAGE_FFMPEG

	help
	  Simple H264 player, with seamless looping and mapping


comment "pmw-vidplayer needs a toolchain w/ C++, threads, dynamic library, egl, openmax and opengles"
	depends on BR2_arm
	depends on !BR2_INSTALL_LIBSTDCPP || !BR2_TOOLCHAIN_HAS_THREADS || \
		BR2_STATIC_LIBS || !BR2_PACKAGE_HAS_LIBEGL || !BR2_PACKAGE_HAS_LIBGLES || !BR2_PACKAGE_HAS_LIBOPENMAX
 
```
